## sdkconfig.defaults
```kconfig
CONFIG_IDF_TARGET="esp32s3"

# N16R8: 16MB flash
CONFIG_ESPTOOLPY_FLASHSIZE_16MB=y

# 板子通过原生 USB (usbmodem) 连接
CONFIG_ESP_CONSOLE_USB_SERIAL_JTAG=y

# HTTP server WebSocket 支持
CONFIG_HTTPD_WS_SUPPORT=y
```
